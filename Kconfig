## Kconfig
```kconfig
config DYA_ANALOG_INPUT
    bool "DYA runtime analog input driver"
    select ADC
    select INPUT
    help
      Runtime-configurable analog input driver for MeKaBu/DYA Studio.

if DYA_ANALOG_INPUT

config DYA_ANALOG_INPUT_USE_DTS_ADC_CH_CFG
    bool "Use per ADC channel config from devicetree"
    help
      Pass the io-channel ADC channel config from devicetree to adc_channel_setup.
      Leave disabled for the nRF52840 defaults used by the original analog driver.

config DYA_ANALOG_INPUT_ADC_RES
    int "ADC resolution"
    default 12

config DYA_ANALOG_INPUT_WORKQUEUE_PRIORITY
    int "Workqueue priority"
    default 10

config DYA_ANALOG_INPUT_WORKQUEUE_STACK_SIZE
    int "Workqueue stack size"
    default 1024

config DYA_ANALOG_INPUT_MAX_DEVICES
    int "Maximum devices exposed to DYA Studio"
    default 1

config DYA_ANALOG_INPUT_STALE_SAMPLE_MS
    int "Milliseconds before stale accumulated deltas are purged"
    default 250

config DYA_ANALOG_INPUT_LOG_DBG_RAW
    bool "Log raw ADC readings"

config DYA_ANALOG_INPUT_LOG_DBG_REPORT
    bool "Log reported input events"

config DYA_ANALOG_INPUT_STUDIO_RPC
    bool "Enable DYA analog input custom Studio RPC"
    depends on ZMK_STUDIO
    help
      Exposes the dya_analog_input custom Studio subsystem used by DYA Studio.

module = DYA_ANALOG_INPUT
module-str = DYA_ANALOG_INPUT
source "${ZEPHYR_BASE}/subsys/logging/Kconfig.template.log_config"

endif
```

## boards/shields/dya_analog_test/Kconfig.shield
```kconfig
config SHIELD_DYA_ANALOG_TEST
    def_bool $(shields_list_contains,dya_analog_test)
```

## dts/bindings/dya,analog-input.yaml
```yaml
# Copyright (c) 2026 The DYA Contributors
# SPDX-License-Identifier: MIT

description: |
  Runtime-configurable analog input driver for MeKaBu/DYA Studio.

compatible: "dya,analog-input"

properties:
  sampling-hz:
    type: int
    default: 100
  report-interval-ms:
    type: int
    default: 0

child-binding:
  description: Per-axis configuration settings
  properties:
    io-channels:
      type: phandle-array
      required: true
    label:
      type: string
    mv-mid:
      type: int
      required: true
    mv-min-max:
      type: int
      required: true
    mv-deadzone:
      type: int
      default: 10
    invert:
      type: boolean
    report-on-change-only:
      type: boolean
    scale-multiplier:
      type: int
      default: 1
    scale-divisor:
      type: int
      default: 70
    evt-type:
      type: int
      required: true
    input-code:
      type: int
      required: true
    output-min:
      type: int
      default: 0
    output-max:
      type: int
      default: 24
    response-curve:
      type: int
      default: 0
      description: 0 = linear, 1 = soft, 2 = aggressive
```
